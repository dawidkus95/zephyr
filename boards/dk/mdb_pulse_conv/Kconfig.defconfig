## boards/dk/mdb_pulse_conv/Kconfig.mdb_pulse_conv
```kconfig
# Copyright (c) 2025 Dawid Kus <dawidkus95@gmail.com>
# SPDX-License-Identifier: Apache-2.0

config BOARD_MDB_PULSE_CONV
	select SOC_STM32G030XX
```
